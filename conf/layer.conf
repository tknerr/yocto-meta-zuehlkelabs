## conf/layer.conf
```bitbake
# We have a conf and classes directory, add to BBPATH
BBPATH .= ":${LAYERDIR}"

# We have recipes-* directories, add to BBFILES
BBFILES += "${LAYERDIR}/recipes-*/*/*.bb \
            ${LAYERDIR}/recipes-*/*/*.bbappend"

BBFILE_COLLECTIONS += "meta-zuehlkelabs"
BBFILE_PATTERN_meta-zuehlkelabs = "^${LAYERDIR}/"
BBFILE_PRIORITY_meta-zuehlkelabs = "7"

LAYERDEPENDS_meta-zuehlkelabs = "core meta-ti"
LAYERSERIES_COMPAT_meta-zuehlkelabs = "dunfell"
```

## conf/machine/zuehlkelabs.conf
```bitbake
#@TYPE: Machine
#@NAME: ZuehlkeLabs machine
#@DESCRIPTION: Machine configuration for the ZuehleLabs BBB

require conf/machine/include/ti-soc.inc

# Processor
DEFAULTTUNE = "armv7athf-neon"
require conf/machine/include/tune-cortexa8.inc

# Kernel
PREFERRED_PROVIDER_virtual/kernel = "linux-ti-staging"
KERNEL_DEVICETREE = "am335x-boneblack.dtb"
KERNEL_IMAGETYPE = "zImage"

# Bootloader
PREFERRED_PROVIDER_virtual/bootloader = "u-boot-ti-staging"
UBOOT_ARCH = "arm"
UBOOT_MACHINE = "am335x_evm_config"
UBOOT_ENTRYPOINT = "0x80008000"
UBOOT_LOADADDRESS = "0x80008000"

# include u-boot in image build
EXTRA_IMAGEDEPENDS += "u-boot"

# Serial console
SERIAL_CONSOLES = "115200;ttyS0"

# List common SoC features
MACHINE_FEATURES = "apm usbgadget usbhost vfat ext2 alsa"
```
